/*
 * Copyright (C) 2013-2015, Megger Instruments, Ltd.
 *
 * This program is free software; you can redistribute it and/or modify
 * it under the terms of the GNU General Public License version 2 as
 * published by the Free Software Foundation.
 */

/dts-v1/;

#include "imx6m300-dl.dtsi"
#include "imx6m300.dtsi"
#include "imx6m300-common.dtsi"

/ {
	model = "Megger Instruments i.MX6 DualLite Mithras 300 Board";
	compatible = "fsl,imx6m300", "fsl,imx6dl";
};


